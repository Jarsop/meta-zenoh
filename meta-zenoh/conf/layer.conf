## meta-zenoh/conf/layer.conf
```bitbake
# We have a conf and classes directory, add to BBPATH
BBPATH .= ":${LAYERDIR}"
# We have recipes-* directories, add to BBFILES
BBFILES += "${LAYERDIR}/recipes-*/*/*.bb \
            ${LAYERDIR}/recipes-*/*/*.bbappend"

BBFILE_COLLECTIONS += "zenoh-layer"
BBFILE_PATTERN_zenoh-layer = "^${LAYERDIR}/"
BBFILE_PRIORITY_zenoh-layer = "9"

# This should only be incremented on significant changes that will
# cause compatibility issues with other layers
LAYERVERSION_zenoh-layer = "1"
LAYERDEPENDS_zenoh-layer = "core"
LAYERSERIES_COMPAT_zenoh-layer = "walnascar"

ZENOH_SHARED_MEMORY ??= "false"
ZENOH_UNSTABLE_API ??= "false"

ZENOH_VERSION ??= "1.7.2"

PREFERRED_VERSION_zenoh                 = "${ZENOH_VERSION}"
PREFERRED_VERSION_zenoh-c               = "${ZENOH_VERSION}"
PREFERRED_VERSION_zenoh-cpp             = "${ZENOH_VERSION}"
PREFERRED_VERSION_zenoh-pico            = "${ZENOH_VERSION}"
PREFERRED_VERSION_python3-eclipse-zenoh = "${ZENOH_VERSION}"
```
